## config/boards/shields/schist01/Kconfig.defconfig
```kconfig
if SHIELD_schist01_LEFT

config ZMK_KEYBOARD_NAME
    default "schist01"

config ZMK_SPLIT_ROLE_CENTRAL
    default y

endif

if SHIELD_schist01_LEFT || SHIELD_schist01_RIGHT

config ZMK_SPLIT
    default y

endif

if SHIELD_schist01_TBALL0 || SHIELD_schist01_TBALL1

config ZMK_SPLIT
    default y

endif

if SHIELD_schist01_TPOINT0

config ZMK_SPLIT
    default y

endif

if SHIELD_schist01_TPAD0

config ZMK_SPLIT
    default y

endif
```

## config/boards/shields/schist01/Kconfig.shield
```kconfig
# Copyright (c) 2020 Pete Johanson
# SPDX-License-Identifier: MIT


config SHIELD_schist01_LEFT
	def_bool $(shields_list_contains,schist01_left)

config SHIELD_schist01_RIGHT
	def_bool $(shields_list_contains,schist01_right)

config SHIELD_schist01_TBALL0
	def_bool $(shields_list_contains,schist01_tball0)

config SHIELD_schist01_TBALL1
	def_bool $(shields_list_contains,schist01_tball1)

config SHIELD_schist01_TPOINT0
	def_bool $(shields_list_contains,schist01_tpoint0)

config SHIELD_schist01_TPAD0
	def_bool $(shields_list_contains,schist01_tpad0)
```
